## stm32f4_baram/boards/arm/stm32f4_baram/Kconfig.board
```kconfig
# Copyright (c) 2020 Brian Bradley
# SPDX-License-Identifier: Apache-2.0

# STM32F411CE based Black Pill V2.0+ board configuration

config BOARD_STM32F4_BARAM
	bool "STM32F4_BARAM Board"
	depends on SOC_STM32F411XE
```

## stm32f4_baram/boards/arm/stm32f4_baram/Kconfig.defconfig
```kconfig
# Copyright (c) 2021 Pete Johanson
# SPDX-License-Identifier: Apache-2.0

# F411CE based Black Pill V2.0+ board board configuration

if BOARD_STM32F4_BARAM

config ZMK_KEYBOARD_NAME
	default "BARAM_F411_KB"

config ZMK_USB
	default y

config ZMK_KSCAN_MATRIX_POLLING
    default y

config ZMK_BACKLIGHT
    select LED
    select LED_GPIO

endif # BOARD_STM32F4_BARAM
```

## stm32f4_baram/boards/arm/stm32f4_baram/stm32f4_baram_defconfig
```kconfig
# SPDX-License-Identifier: Apache-2.0

CONFIG_SOC_SERIES_STM32F4X=y
CONFIG_SOC_STM32F411XE=y

# Enable MPU
CONFIG_ARM_MPU=y

# Enable HW stack protection
CONFIG_HW_STACK_PROTECTION=y

# Serial Drivers
CONFIG_SERIAL=n
CONFIG_UART_INTERRUPT_DRIVEN=n
CONFIG_CONSOLE=n
CONFIG_UART_CONSOLE=n

# Enable GPIO
CONFIG_GPIO=y

# Clock configuration
CONFIG_CLOCK_CONTROL=y

# enable pin controller
CONFIG_PINCTRL=y

CONFIG_USE_DT_CODE_PARTITION=y


# zmk
CONFIG_ZMK_USB=y
CONFIG_ZMK_BLE=n
CONFIG_ZMK_KSCAN_MATRIX_POLLING=n
CONFIG_ZMK_KSCAN_DIRECT_POLLING=y
CONFIG_ZMK_USB_LOGGING=n
```

## zmk-macro/Kconfig.board
```kconfig
# Copyright (c) 2021 Nick Winans
# SPDX-License-Identifier: MIT

config BOARD_ZMK_MACRO
    bool "zmk-macro"
    depends on SOC_NRF52840_QIAA
```
