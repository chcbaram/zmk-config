/*
 * Copyright (c) 2020 The ZMK Contributors
 *
 * SPDX-License-Identifier: MIT
 */

#include <behaviors.dtsi>
#include <dt-bindings/zmk/keys.h>

/* Uncomment and keep whatever encoders are on your BDN9
&sensors {
	status = "okay";
	sensors = <&left_encoder &mid_encoder &right_encoder>;
};
*/

// Uncomment each encoder installed on your BDN9
// &left_encoder { status = "okay"; };
// &mid_encoder { status = "okay"; };
// &right_encoder { status = "okay"; };

/ {


	macros {
		ZMK_MACRO(
			bl_key,
			wait-ms = <0>;
			tap-ms = <20>;
			bindings
				= <&macro_press &mo 1>
        , <&macro_tap &bl BL_ON>
        , <&macro_tap &kp LS(B) &kp LS(L) &kp UNDER &kp LS(K) &kp LS(E) &kp LS(Y) &kp SPACE>

        , <&macro_pause_for_release>
        , <&macro_release &mo 1>
        , <&macro_tap &bl BL_OFF>
        ;
		)
	};

	keymap {
		compatible = "zmk,keymap";

		default_layer {
			bindings = <
				/*&kp LS(K) &bl BL_TOG*/
        &bl_key
			>;
		}; 
	};
};

